## kconfig/Kconfig.zjs
```kconfig
mainmenu "ZJS Configuration"

menu "ZJS Modules"

source "kconfig/modules/Kconfig"

endmenu

menu "Drivers"

source "kconfig/drivers/Kconfig"

endmenu

menu "Networking"

source "kconfig/networking/Kconfig"

endmenu

config GO_TO_LUNCH
	bool "Do you want to get lunch?"
	default y
```

## kconfig/drivers/Kconfig
```kconfig
config USE_BLUETOOTH
	bool "Include bluetooth driver"
	default n

config USE_ETHERNET_BUILTIN
	bool "Includes builtin ethernet driver"
	default n

config USE_ETHERNET_ENJ
	bool "Includes enj ethernet driver
	default n
```

## kconfig/modules/Kconfig
```kconfig
config USE_GPIO
	bool "Enable GPIO"
	default n

config USE_SPI
	bool "Enable SPI"
	default n

config USE_AIO
	bool "Enable AIO"
	default n

config USE_I2C
	bool "Enable I2C"
	default n

menu "Sensors"
	config USE_ACCELL
		bool "Enable Accelerometer"
		default n
	config USE_GYRO
		bool "Enable Gyroscope"
		default n
endmenu

config USE_FILE_SYSTEM
	bool "Enable File System"
	default n
```

## kconfig/networking/Kconfig
```kconfig
config USE_NETWORKING
	bool "Enable networking"
	default n
	default y if USE_ETHERNET_BUILTIN || USE_ETHERNET_ENJ

config USE_IPV4
	bool "Enable IPv4"
	default n

config USE_IPV6
	bool "Enable IPv6"
	default n
```
